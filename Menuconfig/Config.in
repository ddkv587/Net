## Menuconfig/Config.in
```kconfig
#
# For a description of the syntax of this configuration file,
# see scripts/config-language.txt.
#

menu "System Config"
config LOG_ENABLE
	bool "log enable"
	default n

config LOG_LEVEL
	int "log level"
	depends on LOG_ENABLE
	default 3
	help
		LOG_CORE
		LOG_PANIC
		LOG_ERROR
		LOG_DEBUG
		LOG_INFO

config LOG_OUT_FILE
	bool "Log to file"
	depends on LOG_ENABLE
	default n
	help 
		enable/disable to write log file in ./log direction

config LOG_OUT_FILE_PREFIX
	string "log file prefix"
	depends on LOG_OUT_FILE
	default "/tmp/"

endmenu
```
